## conf/layer.conf
```bitbake
# We have a conf and classes directory, add to BBPATH
BBPATH =. "${LAYERDIR}:"

# We have recipes-* directories, add to BBFILES
BBFILES += "${LAYERDIR}/recipes-*/*/*.bb \
            ${LAYERDIR}/recipes-*/*/*.bbappend"

BBFILE_COLLECTIONS += "eid"
BBFILE_PATTERN_eid = "^${LAYERDIR}/"
BBFILE_PRIORITY_eid = "10"

# This should only be incremented on significant changes that will
# cause compatibility issues with other layers
LAYERVERSION_eid = "1"

#LAYERDEPENDS_eid = "core"
```

## conf/local.conf.sample
```bitbake
DEBIAN_REPO = "http://deb.debian.org/debian"
DEBIAN_CODENAME = "buster"

MACHINE = "qemux86-64"
```

## conf/machine/qemuarm.conf
```bitbake
DEB_HOST_ARCH = "armhf"

ARCH ?= "arm"
CROSS_COMPILE ?= "${@bb.utils.contains('DEB_CROSS', '1', 'arm-linux-gnueabihf-', '', d)}"
```

## conf/machine/qemux86-64.conf
```bitbake
DEB_HOST_ARCH = "amd64"

ARCH ?= "x86"
CROSS_COMPILE ?= "${@bb.utils.contains('DEB_CROSS', '1', 'x86_64-linux-gnu-', '', d)}"
```
